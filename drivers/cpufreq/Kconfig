## drivers/cpufreq/Kconfig
```kconfig
menu "CPU Frequency scaling"

config CPU_FREQ
	bool "CPU Frequency scaling"
	select SRCU
	help
	  CPU Frequency scaling allows you to change the clock speed of 
	  CPUs on the fly. This is a nice method to save power, because 
	  the lower the CPU clock speed, the less power the CPU consumes.

	  Note that this driver doesn't automatically change the CPU
	  clock speed, you need to either enable a dynamic cpufreq governor
	  (see below) after boot, or use a userspace tool.

	  For details, take a look at <file:Documentation/cpu-freq>.

	  If in doubt, say N.

if CPU_FREQ

config CPU_FREQ_GOV_ATTR_SET
	bool

config CPU_FREQ_GOV_COMMON
	select CPU_FREQ_GOV_ATTR_SET
	select IRQ_WORK
	bool

config CPU_FREQ_BOOST_SW
	bool
	depends on THERMAL

config CPU_FREQ_STAT
	bool "CPU frequency transition statistics"
	help
	  Export CPU frequency statistics information through sysfs.

	  If in doubt, say N.

config CPU_FREQ_STAT_DETAILS
	bool "CPU frequency transition statistics details"
	depends on CPU_FREQ_STAT
	help
	  Show detailed CPU frequency transition table in sysfs.

	  If in doubt, say N.

config CPU_FREQ_TIMES
       bool "CPU frequency time-in-state statistics"
       default y
       help
         This driver exports CPU time-in-state information through procfs file
         system.

         If in doubt, say N.

choice
	prompt "Default CPUFreq governor"
	default CPU_FREQ_DEFAULT_GOV_USERSPACE if ARM_SA1100_CPUFREQ || ARM_SA1110_CPUFREQ
	default CPU_FREQ_DEFAULT_GOV_PERFORMANCE
	help
	  This option sets which CPUFreq governor shall be loaded at
	  startup. If in doubt, select 'performance'.

config CPU_FREQ_DEFAULT_GOV_PERFORMANCE
	bool "performance"
	select CPU_FREQ_GOV_PERFORMANCE
	help
	  Use the CPUFreq governor 'performance' as default. This sets
	  the frequency statically to the highest frequency supported by
	  the CPU.

config CPU_FREQ_DEFAULT_GOV_POWERSAVE
	bool "powersave"
	select CPU_FREQ_GOV_POWERSAVE
	help
	  Use the CPUFreq governor 'powersave' as default. This sets
	  the frequency statically to the lowest frequency supported by
	  the CPU.

config CPU_FREQ_DEFAULT_GOV_USERSPACE
	bool "userspace"
	select CPU_FREQ_GOV_USERSPACE
	help
	  Use the CPUFreq governor 'userspace' as default. This allows
	  you to set the CPU frequency manually or when a userspace 
	  program shall be able to set the CPU dynamically without having
	  to enable the userspace governor manually.

config CPU_FREQ_DEFAULT_GOV_ONDEMAND
	bool "ondemand"
	select CPU_FREQ_GOV_ONDEMAND
	select CPU_FREQ_GOV_PERFORMANCE
	help
	  Use the CPUFreq governor 'ondemand' as default. This allows
	  you to get a full dynamic frequency capable system by simply
	  loading your cpufreq low-level hardware driver.
	  Be aware that not all cpufreq drivers support the ondemand
	  governor. If unsure have a look at the help section of the
	  driver. Fallback governor will be the performance governor.

config CPU_FREQ_DEFAULT_GOV_HATSUNE
	bool "hatsune"
	select CPU_FREQ_GOV_HATSUNE
	select CPU_FREQ_GOV_PERFORMANCE
	help
	  Use the CPUFreq governor 'hatsune' as default.

config CPU_FREQ_DEFAULT_GOV_CONSERVATIVE
	bool "conservative"
	select CPU_FREQ_GOV_CONSERVATIVE
	select CPU_FREQ_GOV_PERFORMANCE
	help
	  Use the CPUFreq governor 'conservative' as default. This allows
	  you to get a full dynamic frequency capable system by simply
	  loading your cpufreq low-level hardware driver.
	  Be aware that not all cpufreq drivers support the conservative
	  governor. If unsure have a look at the help section of the
	  driver. Fallback governor will be the performance governor.

config CPU_FREQ_DEFAULT_GOV_INTERACTIVE
	bool "interactive"
	select CPU_FREQ_GOV_INTERACTIVE
	select CPU_FREQ_GOV_PERFORMANCE
	help
	  Use the CPUFreq governor 'interactive' as default. This allows
	  you to get a full dynamic cpu frequency capable system by simply
	  loading your cpufreq low-level hardware driver, using the
	  'interactive' governor for latency-sensitive workloads.

config CPU_FREQ_DEFAULT_GOV_SCHEDUTIL
	bool "schedutil"
	depends on SMP
	select CPU_FREQ_GOV_SCHEDUTIL
	select CPU_FREQ_GOV_PERFORMANCE
	help
	  Use the CPUfreq governor 'sched' as default. This scales
	  cpu frequency using CPU utilization estimates from the
	  scheduler.
    
config CPU_FREQ_DEFAULT_GOV_IMPULSE
	bool "impulse"
	select CPU_FREQ_GOV_IMPULSE
	help
	  Use the CPUFreq governor 'impulse' as default. This allows
	  you to get a full dynamic cpu frequency capable system by simply
	  loading your cpufreq low-level hardware driver, using the
	  'impulse' governor for latency-sensitive workloads.
    
config CPU_FREQ_DEFAULT_GOV_ZZMOOVE
	bool "zzmoove"
	select CPU_FREQ_GOV_ZZMOOVE
	select CPU_FREQ_GOV_PERFORMANCE
	help
	  Use the CPUFreq governor 'zzmoove' as default, using predefined
	  frequency lookup tables and optimized scaling triggers instead of
	  % frequency steps to get smooth up/downscaling dependant on CPU load.

config CPU_FREQ_DEFAULT_GOV_ALUCARD
	bool "alucard"
	select CPU_FREQ_GOV_ALUCARD
	help
	  Use the CPUFreq governor 'alucard' as default.
	  
config CPU_FREQ_DEFAULT_GOV_SMARTMAX
  	bool "smartmax"
  	select CPU_FREQ_GOV_SMARTMAX
  	help
  	  Use the CPUFreq governor 'smartmax' as default

config CPU_FREQ_DEFAULT_GOV_INTELLIACTIVE
	bool "intelliactive"
	select CPU_FREQ_GOV_INTELLIACTIVE
	help
	  Use the CPUFreq governor 'intelliactive' as default. This allows
	  you to get a full dynamic cpu frequency capable system by simply
	  loading your cpufreq low-level hardware driver, using the
	  'intelliactive' governor for latency-sensitive workloads.
	  
config CPU_FREQ_DEFAULT_GOV_NIGHTMARE
	bool "nightmare"
	select CPU_FREQ_GOV_NIGHTMARE
	help
	  Use the CPUFreq governor 'nightmare' as default
	  
config CPU_FREQ_DEFAULT_GOV_BLU_ACTIVE
	bool "blu_active"
	select CPU_FREQ_GOV_BLU_ACTIVE
	help
	  Use the CPUFreq governor 'blu_active' as default.
	  
config CPU_FREQ_DEFAULT_GOV_LIONHEART
	bool "lionheart"
	select CPU_FREQ_GOV_LIONHEART
	help
	  Use the CPUFreq governor 'lionheart' as default.
	  
config CPU_FREQ_DEFAULT_GOV_INTERACTIVEX
    bool "interactivex"
    select CPU_FREQ_GOV_INTERACTIVEX
    help
      Use the CPU frequency governor 'interactivex' as default.
      Note that not all cpu frequency drivers supports interactivex governor.
      For more info, take a look at the cpu frequency driver help section.
      Performance governor will be the fallback governor.
      
config CPU_FREQ_DEFAULT_GOV_ONDEMANDX
    bool "ondemandx"
    select CPU_FREQ_GOV_ONDEMANDX	
    help
      Use the CPUFreq governor 'ondemand' as default. This allows
	  you to get a full dynamic frequency capable system by simply
	  loading your cpufreq low-level hardware driver.
	  Be aware that not all cpufreq drivers support the ondemandx
	  governor. If unsure have a look at the help section of the
	  driver.

config CPU_FREQ_DEFAULT_GOV_SKYWALKER
	bool "skywalker"
	select CPU_FREQ_GOV_SKYWALKER
	help
	  Use the CPUFreq governor 'skywalker' as default.

config CPU_FREQ_DEFAULT_GOV_SMARTASS
	bool "smartass"
	select CPU_FREQ_GOV_SMARTASS
	help
	  Use the CPUFreq governor 'smartass' as default.

config CPU_FREQ_DEFAULT_GOV_SMARTASS2
	bool "smartass2"
	select CPU_FREQ_GOV_SMARTASS2
	help
	  Use the CPUFreq governor 'smartass2' as default.

config CPU_FREQ_DEFAULT_GOV_SMARTASSH3
	bool "smartassH3"
	select CPU_FREQ_GOV_SMARTASSH3
	help
	  Use the CPUFreq governor 'smartassH3' as default.

config CPU_FREQ_DEFAULT_GOV_SMARTMAX_EPS
	bool "smartmax_eps"
	select CPU_FREQ_GOV_SMARTMAX_EPS
	help
	  Use the CPUFreq governor 'smartmax_eps' as default.

config CPU_FREQ_DEFAULT_GOV_WREXY
	bool "wrexy"
	select CPU_FREQ_GOV_WREXY
	help
	  Use the CPUFreq governor 'wrexy' as default.

config CPU_FREQ_DEFAULT_GOV_ZENX
	bool "zenx"
	select CPU_FREQ_GOV_ZENX
	help
	  Use the CPUFreq governor 'zenx' as default.

config CPU_FREQ_DEFAULT_GOV_ABYSSPLUG
	bool "abyssplug"
	select CPU_FREQ_GOV_ABYSSPLUG
	help
	  Use the CPUFreq governor 'abyssplug' as default.

config CPU_FREQ_DEFAULT_GOV_ABYSSPLUGV2
	bool "abyssplugv2"
	select CPU_FREQ_GOV_ABYSSPLUGV2
	help
	  Use the CPUFreq governor 'abyssplugv2' as default.

config CPU_FREQ_DEFAULT_GOV_ADAPTIVE
	bool "adaptive"
	select CPU_FREQ_GOV_ADAPTIVE
	help
	  Use the CPUFreq governor 'adaptive' as default.

config CPU_FREQ_DEFAULT_GOV_ADAPTIVEX
	bool "adaptivex"
	select CPU_FREQ_GOV_ADAPTIVEX
	help
	  Use the CPUFreq governor 'adaptivex' as default.

config CPU_FREQ_DEFAULT_GOV_ASSWAX
	bool "asswax"
	select CPU_FREQ_GOV_ASSWAX
	help
	  Use the CPUFreq governor 'asswax' as default.

config CPU_FREQ_DEFAULT_GOV_BADASS
	bool "badass"
	select CPU_FREQ_GOV_BADASS
	help
	  Use the CPUFreq governor 'badass' as default.

config CPU_FREQ_DEFAULT_GOV_BRAZILIANWAX
	bool "brazilianwax"
	select CPU_FREQ_GOV_BRAZILIANWAX
	help
	  Use the CPUFreq governor 'brazilianwax' as default.

config CPU_FREQ_DEFAULT_GOV_HYPER
	bool "hyper"
	select CPU_FREQ_GOV_HYPER
	help
	  Use the CPUFreq governor 'hyper' as default.

config CPU_FREQ_DEFAULT_GOV_INTELLIDEMAND
	bool "intellidemand"
	select CPU_FREQ_GOV_INTELLIDEMAND
	help
	  Use the CPUFreq governor 'intellidemand' as default.

config CPU_FREQ_DEFAULT_GOV_LAGFREE
	bool "lagfree"
	select CPU_FREQ_GOV_LAGFREE
	help
	  Use the CPUFreq governor 'lagfree' as default.

config CPU_FREQ_DEFAULT_GOV_LAZY
	bool "lazy"
	select CPU_FREQ_GOV_LAZY
	help
	  Use the CPUFreq governor 'lazy' as default.

config CPU_FREQ_DEFAULT_GOV_LULZACTIVE
	bool "lulzactive"
	select CPU_FREQ_GOV_LULZACTIVE
	help
	  Use the CPUFreq governor 'lulzactive' as default.

config CPU_FREQ_DEFAULT_GOV_LULZACTIVEW
	bool "lulzactivew"
	select CPU_FREQ_GOV_LULZACTIVEW
	help
	  Use the CPUFreq governor 'lulzactivew' as default.

config CPU_FREQ_DEFAULT_GOV_MINMAX
	bool "minmax"
	select CPU_FREQ_GOV_MINMAX
	help
	  Use the CPUFreq governor 'minmax' as default.

config CPU_FREQ_DEFAULT_GOV_PEGASUSQ
	bool "pegasusq"
	select CPU_FREQ_GOV_PEGASUSQ
	help
	  Use the CPUFreq governor 'pegasusq' as default.

config CPU_FREQ_DEFAULT_GOV_PRESERVATIVE
	bool "preservative"
	select CPU_FREQ_GOV_PRESERVATIVE
	help
	  Use the CPUFreq governor 'preservative' as default.

config CPU_FREQ_DEFAULT_GOV_SAKURACTIVE
	bool "sakuractive"
	select CPU_FREQ_GOV_SAKURACTIVE
	help
	  Use the CPUFreq governor 'sakuractive' as default.

config CPU_FREQ_DEFAULT_GOV_SCARY
	bool "scary"
	select CPU_FREQ_GOV_SCARY
	help
	  Use the CPUFreq governor 'scary' as default.

	  
endchoice

config CPU_FREQ_GOV_PERFORMANCE
	tristate "'performance' governor"
	help
	  This cpufreq governor sets the frequency statically to the
	  highest available CPU frequency.

	  To compile this driver as a module, choose M here: the
	  module will be called cpufreq_performance.

	  If in doubt, say Y.

config CPU_FREQ_GOV_POWERSAVE
	tristate "'powersave' governor"
	help
	  This cpufreq governor sets the frequency statically to the
	  lowest available CPU frequency.

	  To compile this driver as a module, choose M here: the
	  module will be called cpufreq_powersave.

	  If in doubt, say Y.

config CPU_FREQ_GOV_USERSPACE
	tristate "'userspace' governor for userspace frequency scaling"
	help
	  Enable this cpufreq governor when you either want to set the
	  CPU frequency manually or when a userspace program shall
	  be able to set the CPU dynamically, like on LART 
	  <http://www.lartmaker.nl/>.

	  To compile this driver as a module, choose M here: the
	  module will be called cpufreq_userspace.

	  For details, take a look at <file:Documentation/cpu-freq/>.

	  If in doubt, say Y.

config CPU_FREQ_GOV_ONDEMAND
	tristate "'ondemand' cpufreq policy governor"
	select CPU_FREQ_GOV_COMMON
	help
	  'ondemand' - This driver adds a dynamic cpufreq policy governor.
	  The governor does a periodic polling and 
	  changes frequency based on the CPU utilization.
	  The support for this governor depends on CPU capability to
	  do fast frequency switching (i.e, very low latency frequency
	  transitions). 

	  To compile this driver as a module, choose M here: the
	  module will be called cpufreq_ondemand.

	  For details, take a look at linux/Documentation/cpu-freq.

	  If in doubt, say N.

config CPU_FREQ_GOV_HATSUNE
	tristate "'hatsune' cpufreq policy governor"
	depends on CPU_FREQ
	select CPU_FREQ_GOV_COMMON
	help
	  'hatsune' - This driver adds a dynamic cpufreq policy governor
	  OC.  

config CPU_FREQ_GOV_CONSERVATIVE
	tristate "'conservative' cpufreq governor"
	depends on CPU_FREQ
	select CPU_FREQ_GOV_COMMON
	help
	  'conservative' - this driver is rather similar to the 'ondemand'
	  governor both in its source code and its purpose, the difference is
	  its optimisation for better suitability in a battery powered
	  environment.  The frequency is gracefully increased and decreased
	  rather than jumping to 100% when speed is required.

	  If you have a desktop machine then you should really be considering
	  the 'ondemand' governor instead, however if you are using a laptop,
	  PDA or even an AMD64 based computer (due to the unacceptable
	  step-by-step latency issues between the minimum and maximum frequency
	  transitions in the CPU) you will probably want to use this governor.

	  To compile this driver as a module, choose M here: the
	  module will be called cpufreq_conservative.

	  For details, take a look at linux/Documentation/cpu-freq.

	  If in doubt, say N.

config CPU_FREQ_GOV_INTERACTIVE
	tristate "'interactive' cpufreq policy governor"
	depends on CPU_FREQ
	select CPU_FREQ_GOV_ATTR_SET
	select IRQ_WORK
	help
	  'interactive' - This driver adds a dynamic cpufreq policy governor
	  designed for latency-sensitive workloads.

	  This governor attempts to reduce the latency of clock
	  increases so that the system is more responsive to
	  interactive workloads.

	  To compile this driver as a module, choose M here: the
	  module will be called cpufreq_interactive.

	  For details, take a look at linux/Documentation/cpu-freq.

	  If in doubt, say N.

config CPU_FREQ_GOV_SCHEDUTIL
	bool "'schedutil' cpufreq policy governor"
	depends on CPU_FREQ && SMP
	select CPU_FREQ_GOV_ATTR_SET
	select IRQ_WORK
	help
	  This governor makes decisions based on the utilization data provided
	  by the scheduler.  It sets the CPU frequency to be proportional to
	  the utilization/capacity ratio coming from the scheduler.  If the
	  utilization is frequency-invariant, the new frequency is also
	  proportional to the maximum available frequency.  If that is not the
	  case, it is proportional to the current frequency of the CPU.  The
	  frequency tipping point is at utilization/capacity equal to 80% in
	  both cases.

	  If in doubt, say N.

config CPU_FREQ_GOV_IMPULSE
	tristate "'impulse' cpufreq policy governor"
	help
	  'impulse' - This driver adds a dynamic cpufreq policy governor
	  designed for latency-sensitive workloads.

	  If in doubt, say N.
	  
# 'zzmoove' governor
config CPU_FREQ_GOV_ZZMOOVE
	tristate "'zzmoove' cpufreq governor"
	depends on CPU_FREQ
	help
	  'zzmoove' - based on cpufreq_conservative, using predefined
	  frequency lookup tables and optimized scaling triggers instead of
	  % frequency steps to get smooth up/downscaling dependant on CPU load.
	  If in doubt, say N.

# 'alucard' governor
config CPU_FREQ_GOV_ALUCARD
	tristate "'alucard' cpufreq governor"
	depends on CPU_FREQ
	help
	  'alucard' - A dynamic cpufreq governor v3.0 (SnapDragon) by Alucard24@XDA.

	  If in doubt, say N.

# 'abyssplug' governor
config CPU_FREQ_GOV_ABYSSPLUG
    tristate "'abyssplug' cpufreq governor"
    depends on CPU_FREQ
    help
        'abyssplug' - This driver adds a dynamic cpufreq policy governor designed for
        Qualcomm Snapdragon processors with a focus on battery efficiency.
        If in doubt, say N.

# 'abyssplugv2' governor
config CPU_FREQ_GOV_ABYSSPLUGV2
    tristate "'abyssplugv2' cpufreq governor"
    depends on CPU_FREQ
    help
        'abyssplugv2' - An advanced derivative of abyssplug.
        If in doubt, say N.

# 'adaptive' governor
config CPU_FREQ_GOV_ADAPTIVE
    tristate "'adaptive' cpufreq policy governor"
    depends on CPU_FREQ
    help
        'adaptive' - This driver adds a dynamic cpufreq policy governor.
        If in doubt, say N.

# 'adaptivex' governor
config CPU_FREQ_GOV_ADAPTIVEX
    tristate "'adaptivex' cpufreq policy governor"
    depends on CPU_FREQ
    help
        'adaptivex' - An advanced derivative of adaptive.
        If in doubt, say N.

# 'asswax' governor
config CPU_FREQ_GOV_ASSWAX
    tristate "'asswax' cpufreq governor"
    depends on CPU_FREQ
    help
        'asswax' - A governor for S4Pro and other devices with interactivex module.
        If in doubt, say N.

# 'badass' governor
config CPU_FREQ_GOV_BADASS
    tristate "'badass' cpufreq governor"
    depends on CPU_FREQ
    help
        'badass' - A dynamic cpufreq governor by -zeppelinrox.
        If in doubt, say N.

# 'brazilianwax' governor
config CPU_FREQ_GOV_BRAZILIANWAX
    tristate "'brazilianwax' cpufreq governor"
    depends on CPU_FREQ
    help
        'brazilianwax' - Brazilianwax governor for Qualcomm Snapdragon processors.
        If in doubt, say N.

# 'hyper' governor
config CPU_FREQ_GOV_HYPER
    tristate "'hyper' cpufreq governor"
    depends on CPU_FREQ
    help
        'hyper' - Hyper governor for Qualcomm Snapdragon processors.
        If in doubt, say N.

# 'intellidemand' governor
config CPU_FREQ_GOV_INTELLIDEMAND
    tristate "'intellidemand' cpufreq governor"
    depends on CPU_FREQ
    help
        'intellidemand' - Intellidemand governor for Qualcomm Snapdragon processors.
        If in doubt, say N.

# 'interactiveX' governor
config CPU_FREQ_GOV_INTERACTIVEX
    tristate "'interactiveX' cpufreq governor"
    depends on CPU_FREQ
    help
        'interactiveX' - An advanced derivative of the interactive governor.
        If in doubt, say N.

# 'lagfree' governor
config CPU_FREQ_GOV_LAGFREE
    tristate "'lagfree' cpufreq governor"
    depends on CPU_FREQ
    help
        'lagfree' - Lagfree governor for Qualcomm Snapdragon processors.
        If in doubt, say N.

# 'lazy' governor
config CPU_FREQ_GOV_LAZY
    tristate "'lazy' cpufreq governor"
    depends on CPU_FREQ
    help
        'lazy' - Lazy governor for Qualcomm Snapdragon processors.
        If in doubt, say N.

# 'lulzactive' governor
config CPU_FREQ_GOV_LULZACTIVE
    tristate "'lulzactive' cpufreq governor"
    depends on CPU_FREQ
    help
        'lulzactive' - Lulzactive governor for Qualcomm Snapdragon processors.
        If in doubt, say N.

# 'lulzactivew' governor
config CPU_FREQ_GOV_LULZACTIVEW
    tristate "'lulzactivew' cpufreq governor"
    depends on CPU_FREQ
    help
        'lulzactivew' - LulzactiveW governor for Qualcomm Snapdragon processors.
        If in doubt, say N.

# 'minmax' governor
config CPU_FREQ_GOV_MINMAX
    tristate "'minmax' cpufreq governor"
    depends on CPU_FREQ
    help

# 'minmax' governor (lanjutan)
config CPU_FREQ_GOV_MINMAX
    tristate "'minmax' cpufreq governor"
    depends on CPU_FREQ
    help
        'minmax' - Minmax governor for Qualcomm Snapdragon processors.
        If in doubt, say N.

# 'pegasusq' governor
config CPU_FREQ_GOV_PEGASUSQ
    tristate "'pegasusq' cpufreq governor"
    depends on CPU_FREQ
    help
        'pegasusq' - PegasusQ governor for Qualcomm Snapdragon processors.
        If in doubt, say N.

# 'preservative' governor
config CPU_FREQ_GOV_PRESERVATIVE
    tristate "'preservative' cpufreq governor"
    depends on CPU_FREQ
    help
        'preservative' - Preservative governor for Qualcomm Snapdragon processors.
        If in doubt, say N.

# 'sakuractive' governor
config CPU_FREQ_GOV_SAKURAACTIVE
    tristate "'sakuractive' cpufreq governor"
    depends on CPU_FREQ
    help
        'sakuractive' - Sakuractive governor for Qualcomm Snapdragon processors.
        If in doubt, say N.

# 'scary' governor
config CPU_FREQ_GOV_SCARY
    tristate "'scary' cpufreq governor"
    depends on CPU_FREQ
    help
        'scary' - Scary governor for Qualcomm Snapdragon processors.
        If in doubt, say N.

# 'skywalker' governor
config CPU_FREQ_GOV_SKYWALKER
    tristate "'skywalker' cpufreq governor"
    depends on CPU_FREQ
    help
        'skywalker' - Skywalker governor for Qualcomm Snapdragon processors.
        If in doubt, say N.

# 'smartass' governor
config CPU_FREQ_GOV_SMARTASS
    tristate "'smartass' cpufreq governor"
    depends on CPU_FREQ
    help
        'smartass' - Smartass governor for Qualcomm Snapdragon processors.
        If in doubt, say N.

# 'smartass2' governor
config CPU_FREQ_GOV_SMARTASS2
    tristate "'smartass2' cpufreq governor"
    depends on CPU_FREQ
    help
        'smartass2' - SmartassV2 governor for Qualcomm Snapdragon processors.
        If in doubt, say N.

# 'smartassH3' governor
config CPU_FREQ_GOV_SMARTASSH3
    tristate "'smartassH3' cpufreq governor"
    depends on CPU_FREQ
    help
        'smartassH3' - SmartassH3 governor for Qualcomm Snapdragon processors.
        If in doubt, say N.

# 'smartmax_eps' governor
config CPU_FREQ_GOV_SMARTMAX_EPS
    tristate "'smartmax_eps' cpufreq governor"
    depends on CPU_FREQ
    help
        'smartmax_eps' - Smartmax_EPS governor for Qualcomm Snapdragon processors.
        If in doubt, say N.

# 'wrexy' governor
config CPU_FREQ_GOV_WREXY
    tristate "'wrexy' cpufreq governor"
    depends on CPU_FREQ
    help
        'wrexy' - Wrexy governor for Qualcomm Snapdragon processors.
        If in doubt, say N.

# 'zenx' governor
config CPU_FREQ_GOV_ZENX
    tristate "'zenx' cpufreq governor"
    depends on CPU_FREQ
    help
        'zenx' - ZenX governor for Qualcomm Snapdragon processors.
        If in doubt, say N.

config CPU_FREQ_GOV_SMARTMAX
    tristate "'smartmax' cpufreq policy governor"	
    depends on CPU_FREQ	
    help	
      'smartmax' combined ondemand and smartass2

config CPU_FREQ_GOV_INTELLIACTIVE
	tristate "'intelliactive' cpufreq policy governor"
	depends on CPU_FREQ
	help
	  'interactive' - This driver adds a dynamic cpufreq policy governor
	  designed for latency-sensitive workloads.

	  This governor attempts to reduce the latency of clock
	  increases so that the system is more responsive to
	  interactive workloads.

	  For details, take a look at linux/Documentation/cpu-freq.

	  If in doubt, say N.

config CPU_FREQ_GOV_NIGHTMARE
	tristate "'nightmare' cpufreq governor"
	depends on CPU_FREQ
	help
	 A PegasusQ modified, less aggressive and more stable. 
	 A good compromise between performance and battery. 
	 In addition to the SoD is a prevention because it usually does not hotplug.
	 
config CPU_FREQ_GOV_BLU_ACTIVE
	tristate "'blu_active' cpufreq policy governor"
	depends on CPU_FREQ
	help
	  'blu_active' - This driver adds a dynamic cpufreq policy governor
	  designed for latency-sensitive workloads.

	  This governor attempts to reduce the latency of clock
	  increases so that the system is more responsive to
	  interactive workloads.

	  To compile this driver as a module, choose M here: the
	  module will be called cpufreq_blu_active.

	  If in doubt, say N.
	  
config CPU_FREQ_GOV_LIONHEART
	tristate "'lionheart' cpufreq governor"
	depends on CPU_FREQ
	help
	  'lionheart' - A brave and agile conservative-based governor.
	  If in doubt, say N.
	  
config CPU_FREQ_GOV_INTERACTIVEX
    tristate "'interactivex' cpufreq governor"
    depends on CPU_FREQ
    help
      'interactivex' - This driver adds a dynamic cpufreq policy governor
      designed for latency-sensitive workloads.

      This governor attempts to reduce the latency of clock 
      increases so that the system is more responsive to
      interactive workloads.

      To compile this driver as a module, choose M here: the
      module will be called cpufreq_interactivex.

      If in doubt, say N.


      
config CPU_FREQ_GOV_ONDEMANDX
	tristate "'ondemandx' cpufreq policy governor"
	depends on CPU_FREQ
    help
	  Basically ondemand with suspend/wake profiles. No further
	  optimization was done to ondemand, to keep it as close to source
	  as possible.
	  
	  If in doubt, say N.
	  
comment "CPU frequency scaling drivers"

config CPUFREQ_DT
	tristate "Generic DT based cpufreq driver"
	depends on HAVE_CLK && OF
	# if CPU_THERMAL is on and THERMAL=m, CPUFREQ_DT cannot be =y:
	depends on !CPU_THERMAL || THERMAL
	select CPUFREQ_DT_PLATDEV
	select PM_OPP
	help
	  This adds a generic DT based cpufreq driver for frequency management.
	  It supports both uniprocessor (UP) and symmetric multiprocessor (SMP)
	  systems.

	  If in doubt, say N.

config CPUFREQ_DT_PLATDEV
	bool
	help
	  This adds a generic DT based cpufreq platdev driver for frequency
	  management.  This creates a 'cpufreq-dt' platform device, on the
	  supported platforms.

	  If in doubt, say N.

if X86
source "drivers/cpufreq/Kconfig.x86"
endif

if ARM || ARM64
source "drivers/cpufreq/Kconfig.arm"
endif

if PPC32 || PPC64
source "drivers/cpufreq/Kconfig.powerpc"
endif

if AVR32
config AVR32_AT32AP_CPUFREQ
	bool "CPU frequency driver for AT32AP"
	depends on PLATFORM_AT32AP
	default n
	help
	  This enables the CPU frequency driver for AT32AP processors.
	  If in doubt, say N.
endif

if IA64
config IA64_ACPI_CPUFREQ
	tristate "ACPI Processor P-States driver"
	depends on ACPI_PROCESSOR
	help
	This driver adds a CPUFreq driver which utilizes the ACPI
	Processor Performance States.

	For details, take a look at <file:Documentation/cpu-freq/>.

	If in doubt, say N.
endif

if MIPS
config LOONGSON2_CPUFREQ
	tristate "Loongson2 CPUFreq Driver"
	depends on LEMOTE_MACH2F
	help
	  This option adds a CPUFreq driver for loongson processors which
	  support software configurable cpu frequency.

	  Loongson2F and it's successors support this feature.

	  For details, take a look at <file:Documentation/cpu-freq/>.

	  If in doubt, say N.

config LOONGSON1_CPUFREQ
	tristate "Loongson1 CPUFreq Driver"
	depends on LOONGSON1_LS1B
	help
	  This option adds a CPUFreq driver for loongson1 processors which
	  support software configurable cpu frequency.

	  For details, take a look at <file:Documentation/cpu-freq/>.

	  If in doubt, say N.
endif

if SPARC64
config SPARC_US3_CPUFREQ
	tristate "UltraSPARC-III CPU Frequency driver"
	help
	  This adds the CPUFreq driver for UltraSPARC-III processors.

	  For details, take a look at <file:Documentation/cpu-freq>.

	  If in doubt, say N.

config SPARC_US2E_CPUFREQ
	tristate "UltraSPARC-IIe CPU Frequency driver"
	help
	  This adds the CPUFreq driver for UltraSPARC-IIe processors.

	  For details, take a look at <file:Documentation/cpu-freq>.

	  If in doubt, say N.
endif

if SUPERH
config SH_CPU_FREQ
	tristate "SuperH CPU Frequency driver"
	help
	  This adds the cpufreq driver for SuperH. Any CPU that supports
	  clock rate rounding through the clock framework can use this
	  driver. While it will make the kernel slightly larger, this is
	  harmless for CPUs that don't support rate rounding. The driver
	  will also generate a notice in the boot log before disabling
	  itself if the CPU in question is not capable of rate rounding.

	  For details, take a look at <file:Documentation/cpu-freq>.

	  If unsure, say N.
endif

config QORIQ_CPUFREQ
	tristate "CPU frequency scaling driver for Freescale QorIQ SoCs"
	depends on OF && COMMON_CLK && (PPC_E500MC || ARM)
	depends on !CPU_THERMAL || THERMAL
	select CLK_QORIQ
	help
	  This adds the CPUFreq driver support for Freescale QorIQ SoCs
	  which are capable of changing the CPU's frequency dynamically.

endif
endmenu
```
