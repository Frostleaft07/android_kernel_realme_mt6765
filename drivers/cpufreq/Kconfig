## drivers/net/can/can-isotp/Kconfig
```kconfig
config CAN_ISOTP
        tristate "CAN ISO 15765-2 driver"
        help
          Help message of CAN ISO 15765-2
```

## hatsune/Kconfig
```kconfig
menu "Display"

config HATSUNE_Q_DISP
     bool "change limit from 255 to 2047 for brightness"
     default y
     help
     Kalau ROM masih ada masalah brightness, coba set Y config ini, mungkin bisa bantu.
     Android Q harus sih.
     file "android.hardware.light@2.0-service-mediatek" required for GSI, check repo release.

endmenu

menu  "Selinux"

config KERNEL_ALWAYS_PERMISSIVE_MODE
     bool "make kernel always permissive mode"
     default n
     help
     This option for always kernel in permissive mode,
     when u build KernelSU or Apatch this option is recommended.

endmenu

menu "Fix KernelSU"

config FIX_BUGS_KSU
     bool "fix bugs ksu"
     default n
     help
     nyalain ini kalau kernelsu bug habis flash module, bootloop dll.

endmenu
```
